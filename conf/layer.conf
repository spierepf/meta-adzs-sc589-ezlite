## conf/layer.conf
```bitbake
# We have a conf and classes directory, add to BBPATH
BBPATH .= ":${LAYERDIR}"

# We have a recipes-* directories, add to BBFILES
BBFILES += "${LAYERDIR}/recipes-*/*/*.bb \
	${LAYERDIR}/recipes-*/*/*.bbappend"

BBFILE_COLLECTIONS += "adzs-sc589-ezlite"
BBFILE_PATTERN_adzs-sc589-ezlite = "^${LAYERDIR}/"
BBFILE_PRIORITY_adzs-sc589-ezlite = "6"
```

## conf/machine/adzs-sc589-ezlite.conf
```bitbake
#@TYPE: Machine
#@NAME: adzs-sc589-ezlite

#@DESCRIPTION: Machine configuration for adzs-sc589-ezlite systems


PREFERRED_PROVIDER_virtual/kernel ?= "linux-yocto"
PREFERRED_VERSION_linux-yocto ?= "4.1%"

PREFERRED_VERSION_gcc-cross-initial-${TARGET_ARCH} ?= "5.4%"
PREFERRED_VERSION_libgcc-initial ?= "5.4%"
PREFERRED_VERSION_gcc-cross-${TARGET_ARCH} ?= "5.4%"
PREFERRED_VERSION_libgcc ?= "5.4%"
PREFERRED_VERSION_gcc-runtime ?= "5.4%"
PREFERRED_VERSION_gcc ?= "5.4%"

require conf/machine/include/qemu.inc
require conf/machine/include/tune-arm926ejs.inc


KERNEL_IMAGETYPE = "uImage"
KERNEL_DEVICETREE = "sc589-ezkit.dtb"
SERIAL_CONSOLE = "57600 ttySC0"
```
